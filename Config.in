## configs/raspberrypi_socketserver_defconfig
```kconfig
BR2_arm=y

BR2_cortex_a7=y

BR2_ARM_FPU_VFPV4=y


BR2_TOOLCHAIN_BUILDROOT_GLIBC=y

 
BR2_TARGET_GENERIC_GETTY_PORT="ttyAMA0"

BR2_TARGET_GENERIC_ROOT_PASSWD="root"

 
BR2_SYSTEM_DHCP="eth0"

 
BR2_PACKAGE_DROPBEAR=y

 
BR2_PACKAGE_SOCKETSERVER=y

 
BR2_ROOTFS_OVERLAY="$(BR2_EXTERNAL_SOCKETSERVER_PATH)/rootfs-overlay"
```

## package/socketserver/Config.in
```kconfig
config BR2_PACKAGE_SOCKETSERVER

    bool "socketserver"

    help

      Standalone TCP socket server appliance.

      Built as a pure C application and launched at boot via SysVinit.
```
